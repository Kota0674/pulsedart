## CMakeLists.txt
```
cmake_minimum_required(VERSION 3.20.0)

find_package(Zephyr REQUIRED HINTS $ENV{ZEPHYR_BASE})
project(pulsedart_mouse)

# Stock-derived data (PixArt SROM, HyperX LED tables) is not in the repository.
if(CONFIG_PULSEDART_BLOB_PLACEHOLDER)
	# release build: marker bytes, replaced later by tools/make_firmware.py
	set(STOCK_BLOBS src/stock_blobs_placeholder.c)
else()
	set(STOCK_BLOBS src/stock_blobs.c)
	if(NOT EXISTS ${CMAKE_CURRENT_SOURCE_DIR}/${STOCK_BLOBS})
		message(FATAL_ERROR "${STOCK_BLOBS} is missing. Generate it from your own flash dump:\n"
			"  python tools/extract_blobs.py dump/flash.bin\n(see docs/flashing.md)")
	endif()
endif()

target_sources(app PRIVATE
	src/main.c
	src/sensor.c
	src/input.c
	src/leds.c
	src/power.c
	src/settings.c
	src/usb.c
	src/ble.c
	src/esb_link.c
	src/stockcfg.c
	src/actions.c
	src/leds_fx.c
	src/vendor.c
	${STOCK_BLOBS}
)
```

## Kconfig
```
menu "Pulsedart"

config PULSEDART_BLOB_PLACEHOLDER
	bool "Release build: marker bytes instead of the stock-derived data"
	help
	  Links stock_blobs_placeholder.c instead of stock_blobs.c. The image does not work
	  until tools/make_firmware.py has put the PMW3389 SROM and the LED tables from the
	  user's own flash dump in place of the markers.

config PULSEDART_STOCK_USB_ID
	bool "Present the stock USB identity (0951:16E2, HyperX Pulsefire Dart)"
	default y
	help
	  Needed for HyperX NGENUITY to find the mouse. If disabled, the VID/PID below
	  and the name "Pulsedart mouse" are used.

config PULSEDART_USB_VID
	hex "USB vendor ID"
	default 0x2fe3
	help
	  0x2fe3 is the Zephyr project test VID. Fine for a personal device; change
	  it if you own a VID.

config PULSEDART_USB_PID
	hex "USB product ID"
	default 0x0100

config PULSEDART_DFU_PID
	hex "USB product ID in DFU mode"
	default 0x0101

config PULSEDART_ESB_RECORD
	string "Default dongle pairing record (8 hex bytes)"
	default ""
	help
	  Pairing record used when the mouse has not paired itself yet, in the stock
	  format "ch 02 a0 a1 a2 a3 01 ff". Takes precedence over the stock record at
	  0xEF000. Empty = use the stock record.

endmenu

source "Kconfig.zephyr"
```

## prj.conf
```kconfig
# ---- core ----
CONFIG_MAIN_STACK_SIZE=4096
CONFIG_SYSTEM_WORKQUEUE_STACK_SIZE=2048
CONFIG_REBOOT=y
CONFIG_LOG=y
CONFIG_LOG_BACKEND_RTT=y
CONFIG_LOG_BACKEND_UART=n

# ---- peripherals ----
CONFIG_SPI=y
CONFIG_I2C=y
CONFIG_PWM=y
CONFIG_WATCHDOG=y

# ---- persistent settings (own partition @0xF0000) ----
CONFIG_FLASH=y
CONFIG_FLASH_MAP=y
CONFIG_NVS=y
CONFIG_SETTINGS=y
CONFIG_SETTINGS_NVS=y

# ---- USB HID (wired) ----
CONFIG_USB_DEVICE_STACK_NEXT=y
CONFIG_USBD_HID_SUPPORT=y
CONFIG_USBD_LOG_LEVEL_WRN=y
CONFIG_UDC_DRIVER_LOG_LEVEL_WRN=y

# ---- Bluetooth LE HID ----
CONFIG_BT=y
CONFIG_BT_PERIPHERAL=y
CONFIG_BT_DEVICE_NAME="Pulsedart"
CONFIG_BT_DEVICE_APPEARANCE=962
CONFIG_BT_MAX_CONN=1
CONFIG_BT_MAX_PAIRED=4
CONFIG_BT_SMP=y
CONFIG_BT_SETTINGS=y
CONFIG_BT_PRIVACY=n
CONFIG_BT_GATT_AUTO_SEC_REQ=n
CONFIG_BT_HIDS=y
CONFIG_BT_HIDS_INPUT_REP_MAX=3
CONFIG_BT_HIDS_OUTPUT_REP_MAX=0
CONFIG_BT_HIDS_FEATURE_REP_MAX=0
CONFIG_BT_HIDS_DEFAULT_PERM_RW_ENCRYPT=y
CONFIG_BT_BAS=y
CONFIG_BT_DIS=y
CONFIG_BT_DIS_MANUF_NAME=y
CONFIG_BT_DIS_MANUF_NAME_STR="Pulsedart project"
CONFIG_BT_CONN_CTX=y
CONFIG_BT_GATT_UUID16_POOL_SIZE=40
CONFIG_BT_GATT_CHRC_POOL_SIZE=20
CONFIG_BT_ATT_TX_COUNT=5
CONFIG_BT_PERIPHERAL_PREF_MIN_INT=6
CONFIG_BT_PERIPHERAL_PREF_MAX_INT=6
CONFIG_BT_PERIPHERAL_PREF_LATENCY=30
CONFIG_BT_PERIPHERAL_PREF_TIMEOUT=400
# ble.c requests the parameters itself on connect; no second automatic request
CONFIG_BT_GAP_AUTO_UPDATE_CONN_PARAMS=n

# ---- ESB to the stock dongle, sharing the radio with BLE through MPSL timeslots ----
CONFIG_ESB=y
CONFIG_ESB_MAX_PAYLOAD_LENGTH=68
CONFIG_ESB_MPSL_TIMESLOT=y
CONFIG_MPSL_TIMESLOT_SESSION_COUNT=2
CONFIG_CLOCK_CONTROL=y
CONFIG_ESB_CLOCK_INIT=y

# Dongle pairing record. Empty = use the record the stock firmware left at 0xEF000, i.e.
# the dongle this mouse was sold/paired with. To use another dongle without pairing, put
# its record in mouse/local.conf (not in git), e.g.
#   CONFIG_PULSEDART_ESB_RECORD="02 02 4a 91 3c d7 01 ff"
CONFIG_PULSEDART_ESB_RECORD=""

# A host that "forgets" the mouse must be able to pair again without a button combo:
# allow a new Just Works pairing to replace the stored keys of the same peer.
CONFIG_BT_SMP_ALLOW_UNAUTH_OVERWRITE=y

# 3 HIDS input reports (mouse, keyboard, consumer) need more GATT attributes
CONFIG_BT_HIDS_ATTR_MAX=40

# A fatal error (e.g. an MPSL assert) reboots instead of leaving the radio dead
CONFIG_RESET_ON_FATAL_ERROR=y
```

## debug.conf
```kconfig
# Debug build (fw\build-mcuboot.ps1 -Debug): the log also goes to a USB virtual COM port
# (CDC ACM, works without drivers on Windows/Linux/macOS). Not for daily use: it adds
# two USB interfaces next to the stock HID set.
CONFIG_USBD_CDC_ACM_CLASS=y
CONFIG_SERIAL=y
CONFIG_UART_LINE_CTRL=y
# LOG_BACKEND_UART depends on the UART console (the normal build uses the RTT console)
CONFIG_UART_CONSOLE=y
CONFIG_RTT_CONSOLE=n
CONFIG_LOG_BACKEND_UART=y
CONFIG_LOG_BACKEND_UART_AUTOSTART=y
# a bigger buffer so the boot messages survive until a terminal opens the port
CONFIG_LOG_BUFFER_SIZE=4096
```

## release.conf
```kconfig
# Release build (fw\build-release.ps1): marker bytes instead of the stock-derived data.
# The image is completed with tools/make_firmware.py from the user's own flash dump.
CONFIG_PULSEDART_BLOB_PLACEHOLDER=y
```

## debug.overlay
```dts
/* Debug build: CDC ACM virtual COM port for the log (see debug.conf) */
&zephyr_udc0 {
	cdc_acm_uart0: cdc_acm_uart0 {
		compatible = "zephyr,cdc-acm-uart";
	};
};

/ {
	chosen {
		zephyr,console = &cdc_acm_uart0;
	};
};
```

## src/main.c
```c
/*
 * Pulsedart mouse firmware - main loop.
 *
 * Settings, lighting, button actions, macros and the NGENUITY protocol follow the stock
 * firmware 1.1.0.8 (see the reports in re/) and use the stock EEPROM layout. Transports:
 * USB (four HID interfaces like stock) when a host has configured us over the cable,
 * otherwise the selected wireless mode: ESB (HyperX dongle) or Bluetooth LE.
 *
 * Button combos (hold 5 s like stock; press DPI first for the DPI+side ones):
 *   L + R + DPI     pair with a HyperX dongle (switches to ESB mode)
 *   M + DPI         factory reset of all settings (stock)
 *   DPI + Forward   toggle wireless mode ESB <-> BLE (reboots)       [ours]
 *   DPI + Back      BLE: forget all hosts and advertise              [ours]
 * MCUboot recovery (USB DFU): hold L + R + Back while the mouse powers up (fw/mcuboot_hooks).
 */
#include <zephyr/kernel.h>
#include <zephyr/drivers/watchdog.h>
#include <zephyr/drivers/gpio.h>
#include <zephyr/sys/reboot.h>
#include <zephyr/sys/byteorder.h>
#include <zephyr/logging/log.h>
#include <hal/nrf_wdt.h>
#include <hal/nrf_power.h>
#if CONFIG_BOOTLOADER_MCUBOOT
#include <zephyr/dfu/mcuboot.h>
#endif
#include <string.h>

#include "pulsedart.h"
#include "stockcfg.h"
#include "actions.h"
#include "leds_fx.h"
#include "vendor.h"

LOG_MODULE_REGISTER(main, LOG_LEVEL_INF);

#define COMBO_HOLD_MS        5000		/* stock 0x1388 scans */
#define KEEPALIVE_PERIOD_MS  4		/* stock ESB keep-alive */
/*
 * NGENUITY started while the mouse is quiet gets no FF 03 status and shows "Connection
 * lost" (it sends nothing to ask); repeat the status while the dongle link is up, until
 * the host sends its first command (then it knows we are online; a repeat would only
 * trigger more host traffic that keeps the mouse awake). Re-armed on every link edge.
 */
#define STATUS_REPEAT_MS     3000
#define POWER_POLL_MS        5000		/* stock fuel gauge poll */
#define TICK_ACTIVE_MS       1

static const uint8_t poll_div[4] = {8, 4, 2, 1};	/* stock table 0x66f20 */

static K_SEM_DEFINE(tick_sem, 0, 1);
static const struct device *wdt = DEVICE_DT_GET(DT_NODELABEL(wdt0));
static int wdt_channel = -1;

static void tick_fn(struct k_timer *t)
{
	k_sem_give(&tick_sem);
}
static K_TIMER_DEFINE(tick_timer, tick_fn, NULL);

static struct pd_settings *cfg;

/* ---------------- watchdog ---------------- */
static void watchdog_init(void)
{
	struct wdt_timeout_cfg t = {
		.window.max = 3000,
		.flags = WDT_FLAG_RESET_SOC,
	};

	if (!device_is_ready(wdt)) {
		return;
	}
	wdt_channel = wdt_install_timeout(wdt, &t);
	if (wdt_channel >= 0) {
		/* keep counting while the CPU sleeps: a hang that idles the CPU must still reset */
		wdt_setup(wdt, WDT_OPT_PAUSE_HALTED_BY_DBG);
	}
}

static void watchdog_feed(void)
{
	if (wdt_channel >= 0) {
		wdt_feed(wdt, wdt_channel);
	}
	/* the nRF52 WDT survives a soft reset (stock code may have started it): feed every RR */
	uint32_t rren = NRF_WDT->RREN;

	for (int i = 0; i < 8; i++) {
		if (rren & BIT(i)) {
			NRF_WDT->RR[i] = WDT_RR_RR_Reload;
		}
	}
}

/* ---------------- sleep: wait for a pin, like stock 0x56d28 ----------------
 * While idle nothing is polled: the tick drops to SLEEP_TICK_MS (watchdog, power) and a
 * level interrupt on MOTION, a button or a wheel contact wakes the loop.
 */
#define SLEEP_TICK_MS 1000	/* < watchdog 3 s */

static const struct gpio_dt_spec wake_pins[] = {
	GPIO_DT_SPEC_GET(DT_NODELABEL(btn_left), gpios),
	GPIO_DT_SPEC_GET(DT_NODELABEL(btn_right), gpios),
	GPIO_DT_SPEC_GET(DT_NODELABEL(btn_middle), gpios),
	GPIO_DT_SPEC_GET(DT_NODELABEL(btn_dpi), gpios),
	GPIO_DT_SPEC_GET(DT_NODELABEL(btn_fwd), gpios),
	GPIO_DT_SPEC_GET(DT_NODELABEL(btn_back), gpios),
	GPIO_DT_SPEC_GET(DT_PATH(zephyr_user), sensor_motion_gpios),
};
static const struct gpio_dt_spec wake_wheel[] = {
	GPIO_DT_SPEC_GET(DT_PATH(zephyr_user), wheel_a_gpios),
	GPIO_DT_SPEC_GET(DT_PATH(zephyr_user), wheel_b_gpios),
};
static struct gpio_callback wake_cb[2];	/* one per GPIO port */
static atomic_t wake_irq;

static void wake_irqs_off(void)
{
	for (size_t i = 0; i < ARRAY_SIZE(wake_pins); i++) {
		gpio_pin_interrupt_configure_dt(&wake_pins[i], GPIO_INT_DISABLE);
	}
	for (size_t i = 0; i < ARRAY_SIZE(wake_wheel); i++) {
		gpio_pin_interrupt_configure_dt(&wake_wheel[i], GPIO_INT_DISABLE);
	}
}

static void wake_isr(const struct device *port, struct gpio_callback *cb, uint32_t pins)
{
	wake_irqs_off();	/* level interrupts: once is enough */
	atomic_set(&wake_irq, 1);
	k_sem_give(&tick_sem);
}

static void sleep_init(void)
{
	const struct device *ports[2] = {NULL};
	uint32_t masks[2] = {0};

	for (size_t i = 0; i < ARRAY_SIZE(wake_pins) + ARRAY_SIZE(wake_wheel); i++) {
		const struct gpio_dt_spec *s = i < ARRAY_SIZE(wake_pins) ?
			&wake_pins[i] : &wake_wheel[i - ARRAY_SIZE(wake_pins)];
		size_t p = (ports[0] == NULL || ports[0] == s->port) ? 0 : 1;

		ports[p] = s->port;
		masks[p] |= BIT(s->pin);
	}
	for (size_t p = 0; p < 2; p++) {
		if (ports[p]) {
			gpio_init_callback(&wake_cb[p], wake_isr, masks[p]);
			gpio_add_callback(ports[p], &wake_cb[p]);
		}
	}
}

static void sleep_arm(void)
{
	atomic_clear(&wake_irq);
	sensor_prepare_sleep();	/* drain motion so MOTION goes inactive (SPI: before the lock) */

	/* arm everything before the first wake_isr can run and disarm half of it */
	unsigned int key = irq_lock();

	input_prepare_sleep();	/* wheel: pull-ups on, interrupt on the opposite level */
	for (size_t i = 0; i < ARRAY_SIZE(wake_pins); i++) {
		gpio_pin_interrupt_configure_dt(&wake_pins[i], GPIO_INT_LEVEL_ACTIVE);
	}
	irq_unlock(key);
}

/* ---------------- test mode (SWD) ----------------
 * test_cmd, written over SWD: 1 = synthetic motion (+1/-1 px alternating, sensor
 * forced to run mode, LEDs off) to measure the current of a transport without anyone
 * moving the mouse; 2 = stop; 0x10 / 0x11 = reboot into ESB / BLE.
 */
__used volatile uint8_t test_cmd;
static bool test_motion;

/* ---------------- helpers ---------------- */
static void reboot_to_mode(enum wireless_mode m)
{
	stockcfg_flush();
	cfg->mode = m;
	pd_settings_save();
	leds_off();
	k_msleep(50);
	sys_reboot(SYS_REBOOT_COLD);
}

/* debounced BTN_* bits -> stock map entries (0 L, 1 R, 2 M, 3 fwd, 4 back, 5 DPI) */
static uint8_t to_entries(uint8_t btn)
{
	return ((btn & BTN_LEFT) ? BIT(MAP_LEFT) : 0) |
	       ((btn & BTN_RIGHT) ? BIT(MAP_RIGHT) : 0) |
	       ((btn & BTN_MIDDLE) ? BIT(MAP_MIDDLE) : 0) |
	       ((btn & BTN_FORWARD) ? BIT(MAP_FORWARD) : 0) |
	       ((btn & BTN_BACK) ? BIT(MAP_BACK) : 0) |
	       ((btn & BTN_DPI) ? BIT(MAP_DPI) : 0);
}

/* ---------------- combos ---------------- */
#define E(x) BIT(MAP_##x)
static const uint8_t combo_pair = E(LEFT) | E(RIGHT) | E(DPI);
static const uint8_t combo_reset = E(MIDDLE) | E(DPI);
static const uint8_t combo_mode = E(DPI) | E(FORWARD);
static const uint8_t combo_unpair = E(DPI) | E(BACK);

static void status_factory_reset(void);

static void factory_reset(void)
{
	LOG_INF("factory reset");
	stockcfg_defaults(BLK_ALL);
	actions_reset();
	stockcfg_save(BLK_ALL);
	leds_fx_apply_all();
	dpi_apply();
	leds_fx_flash(0xFF, 0xFF, 0xFF);
	status_factory_reset();
}

/*
 * Returns the entries to hide from the button actions. Entries pressed while DPI is
 * held are combo keys (DPI itself too), so DPI's own action does not fire; a button
 * that was already held before DPI (a drag) keeps working.
 */
static uint8_t handle_combos(uint8_t ent, uint8_t prev_ent, int64_t now)
{
	static uint8_t held;
	static int64_t since;
	static bool fired;
	static uint8_t hidden;
	static bool armed;	/* combos act only after all buttons were released once */
	uint8_t pressed = ent & ~prev_ent;

	/* a combo still held across its own reboot must not fire again */
	if (!ent) {
		armed = true;
	}

	if (ent != held) {
		held = ent;
		since = now;
		fired = false;
	}
	const uint8_t *dm = &scfg.btn[MAP_DPI * 3];
	/* DPI is a combo modifier only while it is a DPI-step key (no press action) */
	bool dpi_mod = dm[0] == 7 && dm[1] >= 6 && dm[1] <= 9;

	if (dpi_mod && (ent & E(DPI))) {
		hidden |= pressed & ~E(DPI);
		if (hidden) {
			hidden |= E(DPI);
		}
		if ((ent & (E(LEFT) | E(RIGHT))) == (E(LEFT) | E(RIGHT))) {
			hidden |= E(LEFT) | E(RIGHT) | E(DPI);
		}
	}
	hidden &= ent;

	if (armed && !fired && now - since >= COMBO_HOLD_MS) {
		if (ent == combo_pair) {
			fired = true;
			if (cfg->mode != MODE_ESB) {
				cfg->pair_on_boot = 1;
				reboot_to_mode(MODE_ESB);
			}
			esbl_start_pairing();
		} else if (ent == combo_reset) {
			fired = true;
			factory_reset();
		} else if (ent == combo_mode) {
			fired = true;
			reboot_to_mode(cfg->mode == MODE_ESB ? MODE_BLE : MODE_ESB);
		} else if (ent == combo_unpair && cfg->mode == MODE_BLE) {
			fired = true;
			ble_unpair_all();
			leds_fx_flash(0, 0, 0xFF);
		}
	}
	if (fired) {
		/* stock: combo keys are released on the host and swallowed until let go */
		hidden |= ent;
	}
	return hidden;
}

/* ---------------- power / battery indications ---------------- */
static void power_poll(void)
{
	const struct power_status *p = power_get();
	uint8_t level = 0;

	power_update();
	if (!p->ext_power && p->soc <= 100) {
		if (p->soc < 5) {
			level = 1;
		} else if (p->soc <= scfg.misc[MISC_LOWBAT_PCT]) {
			level = 2;
		}
	}
	leds_fx_set_lowbat(level);
	leds_fx_set_charging(p->ext_power && p->charging);
	if (cfg->mode == MODE_BLE) {
		ble_set_battery(p->soc);
	}
}

/* ---------------- report sending ---------------- */
static int send_mouse(const struct mouse_report *r)
{
	if (usb_ready()) {
		return usb_send(r);
	}
	return cfg->mode == MODE_BLE ? ble_send(r) : esbl_send(r);
}

static int send_kbd(uint8_t mod, const uint8_t keys[6])
{
	if (usb_ready()) {
		return usb_send_kbd(mod, keys);
	}
	return cfg->mode == MODE_BLE ? ble_send_kbd(mod, keys) : esbl_send_kbd(mod, keys);
}

static int send_consumer(uint16_t usage)
{
	if (usb_ready()) {
		return usb_send_consumer(usage);
	}
	return cfg->mode == MODE_BLE ? ble_send_consumer(usage) : esbl_send_consumer(usage);
}

static inline bool retry(int err)
{
	return err == -EBUSY || err == -ENOMEM;
}

/* ---------------- async status FF 03 (re/status_ff03.md) ----------------
 * [2] DPI stage, [3] power state, [4] awake (NGENUITY's "wireless mouse online"),
 * [5] sniper held, [6] factory reset done, [7] held buttons 0..5. Armed by button
 * edges (4), wake / wireless boot / power change / factory reset (2); counts down on
 * ticks that send no other report, then goes to the host on USB IF1 or as a 0xE0
 * packet through the dongle.
 */
#define STATUS_GIVE_UP_MS 1000

static uint8_t st[8] = {0xFF, 0x03};
static uint8_t st_countdown;
static bool st_pending;
static uint32_t st_wait_ms;

static uint8_t power_state(void)
{
	const struct power_status *p = power_get();

	return p->ext_power ? (p->charging ? 1 : 3) : 0;	/* same encoding as 51 00 */
}

static void status_arm(uint8_t n)
{
	if (!esbl_pairing()) {	/* stock: no status while pairing */
		st_countdown = n;
		st_pending = false;
	}
}

static void status_factory_reset(void)
{
	st[6] = 1;
	st_countdown = 2;	/* stock 0x5aa28: also while pairing */
	st_pending = false;
}

/*
 * External power keeps the mouse awake like stock: a cable does, a Qi pad does not
 * (stock idles when powered with P0.14 = 1, re/power.md 5.3).
 */
static bool power_keeps_awake(void)
{
	const struct power_status *p = power_get();

	return p->ext_power && !p->qi;
}

/* returns true if the status went out this tick */
static bool status_tick(bool other_sent, bool awake, uint8_t ent, uint32_t dt)
{
	if (esbl_pairing()) {
		return false;	/* stock: the countdown is frozen while pairing */
	}
	if (st_countdown && !other_sent && --st_countdown == 0) {
		st_pending = true;
		st_wait_ms = 0;
	}
	if (!st_pending || other_sent) {
		return false;
	}
	st[2] = dpi_current();
	st[3] = power_state();
	st[4] = awake;
	st[5] = dpi_sniper_active();
	st[7] = ent & 0x3F;

	int e = usb_ready()		 ? usb_send_status(st)
		: cfg->mode == MODE_ESB ? esbl_send_status(st)
					 : -ENOTSUP;	/* BLE: stock has no such path */

	if (e == 0) {
		st[6] = 0;
		st_pending = false;
		return true;
	}
	if ((e != -EBUSY && e != -EAGAIN) || (st_wait_ms += dt) >= STATUS_GIVE_UP_MS) {
		st_pending = false;
	}
	return false;
}

int main(void)
{
	struct host_state hs = {0};
	struct mouse_report acc = {0};
	uint8_t sent_mbtn = 0, sent_kmod = 0, sent_keys[6] = {0};
	uint16_t sent_consumer = 0;
	bool kbd_force = false, consumer_force = false;
	uint8_t prev_ent = 0;
	int64_t last_activity, last_power_poll = -POWER_POLL_MS;
	uint32_t ms_since_send = 0, ms_since_report = 0, ms_since_status = 0;
	bool host_talking = false, usb_was = false, leds_off_now = false;
	bool idle = false;
	int err;

	/* log and clear the reset reason (the register accumulates across resets) */
	uint32_t reas = NRF_POWER->RESETREAS;

	NRF_POWER->RESETREAS = reas;
	LOG_INF("Pulsedart firmware " __DATE__ " " __TIME__ ", reset reason 0x%05x%s%s%s%s", reas,
		(reas & POWER_RESETREAS_DOG_Msk) ? " WATCHDOG" : "",
		(reas & POWER_RESETREAS_SREQ_Msk) ? " soft" : "",
		(reas & POWER_RESETREAS_OFF_Msk) ? " wake-from-OFF" : "",
		(reas & POWER_RESETREAS_LOCKUP_Msk) ? " LOCKUP" : "");
	watchdog_init();
#if CONFIG_BOOTLOADER_MCUBOOT
	/* overwrite-only MCUboot needs no confirmation; harmless if already confirmed */
	boot_write_img_confirmed();
#endif

	pd_settings_init();
	cfg = pd_settings_get();
	leds_init();
	power_init();
	stockcfg_init();

	/* stock boot overrides (not written back): debounce 5/18, idle 10.5 s / 60 s */
	scfg.cfg[CFG_DEBOUNCE_PRESS] = 5;
	scfg.cfg[CFG_DEBOUNCE_RELEASE] = 18;
	sys_put_le32(10500, &scfg.cfg[CFG_IDLE_T1]);
	sys_put_le32(60000, &scfg.cfg[CFG_IDLE_T2]);

	input_init();
	sleep_init();
	leds_fx_init();

	err = sensor_init();
	if (err) {
		LOG_ERR("sensor init %d", err);
	}
	actions_init();

	err = usb_init();
	if (err) {
		LOG_ERR("USB init %d", err);
	}

	if (cfg->mode == MODE_BLE) {
		err = ble_start();
		ble_set_battery(power_get()->soc);
		leds_fx_flash(0x00, 0x00, 0xFF);
	} else {
		err = esbl_start();
		leds_fx_flash(0x00, 0xFF, 0x00);
		if (cfg->pair_on_boot) {
			cfg->pair_on_boot = 0;
			pd_settings_save();
			esbl_start_pairing();
		}
	}
	if (err) {
		LOG_ERR("wireless start %d", err);
	}
	status_arm(2);	/* stock: RW default countdown + "became active" at boot */
	uint8_t prev_pwr = power_state();


	last_activity = k_uptime_get();
	k_timer_start(&tick_timer, K_MSEC(TICK_ACTIVE_MS), K_MSEC(TICK_ACTIVE_MS));
	int64_t prev_tick = k_uptime_get();

	while (1) {
		k_sem_take(&tick_sem, K_FOREVER);
		watchdog_feed();
		int64_t now = k_uptime_get();
		/* measured, so a slow iteration does not slow debounce, macros, LEDs */
		uint32_t dt = (uint32_t)CLAMP(now - prev_tick, 1, 100);

		prev_tick = now;

		if (test_cmd) {
			uint8_t c = test_cmd;

			test_cmd = 0;
			if (c == 1 || c == 2) {
				test_motion = c == 1;
				if (test_motion) {
					atomic_set(&wake_irq, 1);	/* leave sleep */
				}
				sensor_set_rest(!test_motion);
				LOG_INF("test motion %s", test_motion ? "on" : "off");
			} else if (c == 0x10 || c == 0x11) {
				reboot_to_mode(c == 0x10 ? MODE_ESB : MODE_BLE);
			}
		}
		/* ---- sleep (stock WFE loop): nothing is polled until a wake pin fires ---- */
		bool woke = false;

		if (idle) {
			if (!atomic_clear(&wake_irq) && !usb_ready()) {
				if (now - last_power_poll >= POWER_POLL_MS) {
					last_power_poll = now;
					power_poll();
				}
				if (!power_keeps_awake()) {	/* cable power: 5 s poll (stock: P1.06 pin) */
					continue;
				}
			}
			wake_irqs_off();
			woke = true;
			dt = 1;	/* not a 100 ms step: keep debounce and timing normal */
		}

		/* ---- inputs ---- */
		input_set_debounce(scfg.cfg[CFG_DEBOUNCE_PRESS], scfg.cfg[CFG_DEBOUNCE_RELEASE]);
		uint8_t ent = to_entries(input_poll_buttons(dt));
		int8_t wheel = input_poll_wheel();
		int16_t dx, dy;
		bool moved = sensor_read_motion(&dx, &dy);

		if (test_motion) {
			static int8_t sign = 1;

			dx = sign;
			dy = 0;
			sign = -sign;
			moved = true;
		}

		if (moved) {
			acc.dx = CLAMP(acc.dx + dx, INT16_MIN + 1, INT16_MAX);
			acc.dy = CLAMP(acc.dy + dy, INT16_MIN + 1, INT16_MAX);
		}
		if (moved || wheel || ent || actions_busy() || esbl_take_tunnel_activity() || woke) {
			last_activity = now;
			if (cfg->mode == MODE_BLE) {
				ble_activity();
			}
			if (idle) {
				idle = false;
				k_timer_start(&tick_timer, K_MSEC(TICK_ACTIVE_MS),
					      K_MSEC(TICK_ACTIVE_MS));
				esbl_set_idle(false);
				status_arm(2);	/* stock 0x5aea6: tells NGENUITY we are back */
				LOG_INF("wake from idle");
			}
		}

		/* ---- combos, actions, macros ---- */
		actions_set_suppressed(handle_combos(ent, prev_ent, now));
		if (ent != prev_ent) {
			status_arm(4);	/* stock 0x58426: every physical press / release */
		}
		prev_ent = ent;
		actions_tick(ent, wheel, dt, &hs);

		esbl_tick_1ms();
		if (esbl_take_tunnel_seen()) {
			host_talking = true;	/* NGENUITY knows we are online: no heartbeat needed */
		}
		bool usb_now = usb_ready();

		if (usb_was && !usb_now) {
			status_arm(2);	/* back on wireless after a cable session */
		}
		usb_was = usb_now;
		if (esbl_take_link_edge()) {
			status_arm(50);	/* let the dongle settle its link-alive first */
			ms_since_status = 0;
			host_talking = false;
		} else if (cfg->mode == MODE_ESB && !usb_now && esbl_ready() && !host_talking &&
			   (ms_since_status += dt) >= STATUS_REPEAT_MS) {
			ms_since_status = 0;
			if (!st_countdown && !st_pending) {
				status_arm(1);
			}
		}
		usb_poll();
		vendor_poll();

		/* ---- reports ---- */
		int sent = -EAGAIN;

		/* a lost 0x60/0x61/0x62: resend that state even if nothing changed */
		if (cfg->mode == MODE_ESB) {
			uint8_t lost = esbl_take_lost();

			if (lost & ESB_LOST_MOUSE) {
				sent_mbtn = 0xFF;
			}
			kbd_force |= !!(lost & ESB_LOST_KBD);
			consumer_force |= !!(lost & ESB_LOST_CONSUMER);
		}

		/* keyboard / consumer: on change */
		if (kbd_force || hs.kmod != sent_kmod || memcmp(hs.keys, sent_keys, 6)) {
			int e = send_kbd(hs.kmod, hs.keys);

			if (!retry(e)) {
				sent_kmod = hs.kmod;
				memcpy(sent_keys, hs.keys, 6);
				kbd_force = false;
			}
			if (!e) {
				sent = 0;
			}
		} else if (consumer_force || hs.consumer != sent_consumer) {
			int e = send_consumer(hs.consumer);

			if (!retry(e)) {
				sent_consumer = hs.consumer;
				consumer_force = false;
			}
			if (!e) {
				sent = 0;
			}
		}

		/* mouse: at the selected polling rate (stock divider 8/4/2/1 ms) */
		acc.buttons = hs.mbtn;
		acc.wheel = hs.wheel;
		ms_since_report += dt;
		bool dirty = acc.dx || acc.dy || acc.wheel || acc.buttons != sent_mbtn;

		if (dirty && sent != 0 &&
		    ms_since_report >= poll_div[scfg.cfg[CFG_POLL_IDX] & 3]) {
			sent = send_mouse(&acc);
			if (sent == 0) {
				sent_mbtn = acc.buttons;
				ms_since_report = 0;
			}
			/* keep motion only while the link is merely busy; never replay stale motion */
			if (!retry(sent)) {
				acc.dx = acc.dy = 0;
				hs.wheel = 0;
			}
		}
		/* macro handshake: the next event waits until this one reached the host */
		actions_host_synced(hs.mbtn == sent_mbtn && hs.wheel == 0,
				    !kbd_force && hs.kmod == sent_kmod && !memcmp(hs.keys, sent_keys, 6));

		/* awake: stock 0x5aea2 / 0x5aec2 / 0x5a50e */
		if (status_tick(sent == 0, !idle && !usb_ready(), ent, dt)) {
			sent = 0;
		}

		if (sent == 0) {
			ms_since_send = 0;
		} else if ((ms_since_send += dt) >= KEEPALIVE_PERIOD_MS && cfg->mode == MODE_ESB &&
			   !idle && !usb_ready()) {
			esbl_keepalive();
			ms_since_send = 0;
		}

		/* ---- power, LEDs ---- */
		if (now - last_power_poll >= POWER_POLL_MS) {
			last_power_poll = now;
			power_poll();
			if (power_state() != prev_pwr) {
				prev_pwr = power_state();
				status_arm(2);	/* stock 0x5a55e */
			}
		}
		leds_fx_set_pairing(esbl_pairing());
		/* stock: LEDs off when the host sleeps and when the mouse idles on battery */
		bool leds_off_want = usb_suspended() || idle || test_motion;

		if (leds_off_want != leds_off_now) {
			leds_fx_suspend(leds_off_want);
			leds_off_now = leds_off_want;
		}
		leds_fx_tick(dt);

		/* ---- idle / sleep ---- */
		if (power_keeps_awake() || usb_ready() || esbl_pairing()) {
			last_activity = now;
		}
		if (!idle && now - last_activity >= sys_get_le32(&scfg.cfg[CFG_IDLE_T1])) {
			idle = true;
			/* stock 0x5ae58 / 0x56d28: keep-alives stop and the radio goes off */
			esbl_set_idle(true);
			leds_fx_suspend(true);
			leds_off_now = true;
			k_timer_start(&tick_timer, K_MSEC(SLEEP_TICK_MS), K_MSEC(SLEEP_TICK_MS));
			sleep_arm();
			LOG_INF("idle");
		}
	}
	return 0;
}
```

## src/actions.c
```c
/*
 * Stock-compatible button actions and macros (re/actions_macros.md), with the stock
 * bugs fixed: full keyboard report (all modifiers, 6 keys), macro event count from the
 * stored counters, delay >= 1 ms, bounded data, macro wheel over every transport,
 * everything a macro pressed is released when it stops.
 */
#include <zephyr/kernel.h>
#include <zephyr/logging/log.h>
#include <string.h>

#include "pulsedart.h"
#include "stockcfg.h"
#include "actions.h"
#include "leds_fx.h"

LOG_MODULE_REGISTER(actions, LOG_LEVEL_INF);

#define T_MOUSE    1
#define T_KEY      2
#define T_CONSUMER 3
#define T_MACRO    4
#define T_SPECIAL  7

#define SP_DPI_UP        6
#define SP_DPI_DOWN      7
#define SP_DPI_UP_WRAP   8
#define SP_DPI_DOWN_WRAP 9
#define SP_SNIPER        0x0B

#define WHEEL_UP_CODE    0xE8
#define WHEEL_DOWN_CODE  0xE9

#define MACRO_START_DELAY_MS 100	/* stock: first event 100 ms after the press */
#define MP_OUT_MOUSE      1
#define MP_OUT_KBD        2
#define MP_OUT_TIMEOUT_MS 100	/* link down: do not stall a macro forever */
#define MACRO_PASS_GAP_MS    2

/* stock table 0x66953: code 1..5 -> HID bit (4 = button 5, 5 = button 4) */
static const uint8_t mouse_bit[6] = {0, 0x01, 0x02, 0x04, 0x10, 0x08};
/* stock table 0x6694c: consumer code 0..6 */
static const uint16_t consumer_usage[7] = {0xCD, 0xB7, 0xB6, 0xB5, 0xE2, 0xEA, 0xE9};

static uint8_t prev_phys;
static uint8_t suppressed;
/* wheel entries mapped to non-wheel actions: pressed for TAP_MS, then released */
#define TAP_MS 20
static int16_t tap_left_ms[2];

/* per-entry resources, so only the owner releases what it pressed */
static uint8_t own_mbtn[BTN_MAP_ENTRIES];
static uint8_t own_key[BTN_MAP_ENTRIES];
static uint16_t own_consumer[BTN_MAP_ENTRIES];

static uint8_t btn_keys[6];	/* keyboard usages held by buttons (incl. modifiers) */
static int8_t btn_wheel;	/* steps from buttons 0..5 mapped to 0xE8/0xE9 */
static uint8_t consumer_owner = 0xFF;

/* ---------------- DPI ---------------- */
static bool sniper;
static uint8_t sniper_owner = 0xFF;

uint8_t dpi_current(void)
{
	return scfg.dpi[DPI_CUR];
}

bool dpi_sniper_active(void)
{
	return sniper;
}

void dpi_apply(void)
{
	uint16_t v = sniper ? sc_get16(&scfg.dpi[DPI_SNIPER])
			    : sc_get16(&scfg.dpi[DPI_VAL(scfg.dpi[DPI_CUR])]);

	sensor_set_cpi(CLAMP(v, 2, 320) * 50);
}

void dpi_select(uint8_t stage)
{
	if (stage >= DPI_STAGES || !(scfg.dpi[DPI_MASK] & BIT(stage))) {
		return;
	}
	scfg.dpi[DPI_CUR] = stage;
	dpi_apply();
	leds_fx_indicate_dpi(stage);
}

/* stock 0x62e34: step through the enabled stages */
void dpi_step(uint8_t mode)
{
	uint8_t mask = scfg.dpi[DPI_MASK] & 0x1F;
	int cur = scfg.dpi[DPI_CUR];
	bool up = mode == 0 || mode == 2;
	bool wrap = mode >= 2;

	if (!mask) {
		return;
	}
	for (int n = 0; n < DPI_STAGES; n++) {
		cur += up ? 1 : -1;
		if (cur >= DPI_STAGES || cur < 0) {
			if (!wrap) {
				/* stop at the last / first enabled stage; stock still pulses the LEDs */
				leds_fx_indicate_dpi(scfg.dpi[DPI_CUR]);
				return;
			}
			cur = up ? 0 : DPI_STAGES - 1;
		}
		if (mask & BIT(cur)) {
			dpi_select(cur);	/* RAM only; NGENUITY persists it with DE 3 / DE FF */
			return;
		}
	}
}

/* ---------------- keyboard helpers ---------------- */
static void key_add(uint8_t usage)
{
	for (int i = 0; i < 6; i++) {
		if (btn_keys[i] == usage) {
			return;
		}
	}
	for (int i = 0; i < 6; i++) {
		if (!btn_keys[i]) {
			btn_keys[i] = usage;
			return;
		}
	}
	btn_keys[5] = usage;	/* full: overwrite the last slot, as stock */
}

static void key_remove(uint8_t usage)
{
	for (int i = 0; i < 6; i++) {
		if (btn_keys[i] == usage) {
			memmove(&btn_keys[i], &btn_keys[i + 1], 5 - i);
			btn_keys[5] = 0;
			return;
		}
	}
}

/* ---------------- macro player ---------------- */
static struct {
	bool running;
	uint8_t idx;		/* macro index */
	uint8_t entry;		/* map entry that started it */
	uint8_t mode;
	uint16_t count;		/* events per pass */
	uint16_t played;
	uint16_t off;
	uint16_t passes;
	uint16_t repeat;
	int32_t wait_ms;
	/* current output of the macro */
	uint8_t mbtn;
	int8_t wheel;
	uint8_t kmod;
	uint8_t keys[6];
	uint8_t out_wait;	/* MP_OUT_*: last event's output not yet reported */
	uint16_t out_wait_ms;
} mp;

static uint16_t macro_event_count(uint8_t i)
{
	const uint8_t *h = scfg.macro_hdr[i];

	/* stock uses len's low byte as a count; the recounted n5 + n10 are reliable */
	return sc_get16(&h[2]) + sc_get16(&h[4]);
}

static void macro_stop(void)
{
	mp.running = false;
	mp.out_wait = 0;
	mp.mbtn = 0;
	mp.wheel = 0;
	mp.kmod = 0;
	memset(mp.keys, 0, sizeof(mp.keys));
}

static void macro_start(uint8_t idx, uint8_t entry)
{
	if (idx >= MACROS || macro_event_count(idx) == 0) {
		return;
	}
	const uint8_t *h = scfg.macro_hdr[idx];

	macro_stop();
	mp.running = true;
	mp.idx = idx;
	mp.entry = entry;
	mp.mode = h[6] & 3;
	mp.count = macro_event_count(idx);
	mp.repeat = mp.mode == 1 ? MAX(h[7] | (h[8] << 8), 1) : 1;
	mp.played = 0;
	mp.off = 0;
	mp.passes = 0;
	mp.wait_ms = MACRO_START_DELAY_MS;
}

static void macro_tick(uint32_t elapsed_ms)
{
	if (!mp.running) {
		return;
	}
	mp.wait_ms -= elapsed_ms;
	if (mp.out_wait) {
		mp.out_wait_ms += elapsed_ms;
	}
	while (mp.running && mp.wait_ms <= 0) {
		const uint8_t *d = scfg.macro_data[mp.idx];

		/* stock 0x62980: the next event waits until the previous one was reported */
		if (mp.out_wait && mp.out_wait_ms < MP_OUT_TIMEOUT_MS) {
			mp.wait_ms = 1;
			break;
		}
		mp.out_wait = 0;

		if (mp.played >= mp.count) {
			/* end of pass */
			mp.passes++;
			if ((mp.mode == 1 && mp.passes < mp.repeat) || mp.mode == 2 || mp.mode == 3) {
				mp.played = 0;
				mp.off = 0;
				mp.wait_ms += MACRO_PASS_GAP_MS;
				continue;
			}
			macro_stop();
			return;
		}
		uint16_t delay;

		if (d[mp.off] == 0x1A) {
			if (mp.off + 10 > MACRO_DATA_LEN) {
				macro_stop();
				return;
			}
			mp.kmod = d[mp.off + 1];
			memcpy(mp.keys, &d[mp.off + 2], 6);
			delay = sc_get16(&d[mp.off + 8]);
			mp.off += 10;
			mp.out_wait = MP_OUT_KBD;
		} else {
			if (mp.off + 5 > MACRO_DATA_LEN) {
				macro_stop();
				return;
			}
			mp.mbtn = d[mp.off + 1] & 0x1F;
			mp.wheel += (int8_t)d[mp.off + 2];
			delay = sc_get16(&d[mp.off + 3]);
			mp.off += 5;
			mp.out_wait = MP_OUT_MOUSE;
		}
		mp.out_wait_ms = 0;
		mp.played++;
		mp.wait_ms += MAX(delay, 1);	/* stock reboots on a 0 ms delay */
	}
}

bool actions_busy(void)
{
	return mp.running || sniper;
}

/* ---------------- dispatcher ---------------- */
static void press(uint8_t entry)
{
	const uint8_t *m = &scfg.btn[entry * 3];
	uint8_t type = m[0], code = m[1], aux = m[2];

	switch (type) {
	case T_MOUSE:
		if (code >= 1 && code <= 5) {
			own_mbtn[entry] = mouse_bit[code];
		} else if (code == WHEEL_UP_CODE) {
			btn_wheel++;	/* stock: one scroll step per press */
		} else if (code == WHEEL_DOWN_CODE) {
			btn_wheel--;
		}
		break;
	case T_KEY:
		if (aux) {
			own_key[entry] = aux;
			key_add(aux);
		}
		break;
	case T_CONSUMER:
		if ((code & 0xF) < ARRAY_SIZE(consumer_usage)) {
			own_consumer[entry] = consumer_usage[code & 0xF];
			consumer_owner = entry;	/* stock: last press wins */
		}
		break;
	case T_MACRO:
		/* a press while a toggle macro runs stops it; otherwise (re)start */
		if (mp.running && mp.mode == 2) {
			macro_stop();
		} else {
			macro_start(code, entry);
		}
		break;
	case T_SPECIAL:
		if (code == SP_SNIPER) {
			sniper = true;
			sniper_owner = entry;
			dpi_apply();
		}
		break;
	default:
		break;
	}
}

/* drop what this entry holds; a key shared with another held entry stays */
static void drop_owned(uint8_t entry)
{
	uint8_t k = own_key[entry];

	own_mbtn[entry] = 0;
	own_key[entry] = 0;
	if (k) {
		bool other = false;

		for (int e = 0; e < BTN_MAP_ENTRIES; e++) {
			other |= own_key[e] == k;
		}
		if (!other) {
			key_remove(k);
		}
	}
	own_consumer[entry] = 0;
	if (consumer_owner == entry) {
		consumer_owner = 0xFF;
	}
}

static void release(uint8_t entry)
{
	const uint8_t *m = &scfg.btn[entry * 3];
	uint8_t type = m[0], code = m[1];

	drop_owned(entry);

	/* what this entry started ends with it, whatever the map says now */
	if (mp.running && mp.mode == 3 && mp.entry == entry) {
		macro_stop();
	}
	if (sniper_owner == entry) {
		sniper = false;
		sniper_owner = 0xFF;
		dpi_apply();
		return;
	}
	if (type == T_SPECIAL && code >= SP_DPI_UP && code <= SP_DPI_DOWN_WRAP && !sniper) {
		dpi_step(code - SP_DPI_UP);	/* stock: on release, not while sniper is held */
	}
}

/* a wheel detent is a press + release of entry 6/7 (stock) */
static void wheel_tap(uint8_t entry, struct host_state *hs)
{
	const uint8_t *m = &scfg.btn[entry * 3];

	if (m[0] == T_MOUSE && (m[1] == WHEEL_UP_CODE || m[1] == WHEEL_DOWN_CODE)) {
		int w = hs->wheel + (m[1] == WHEEL_UP_CODE ? 1 : -1);

		hs->wheel = CLAMP(w, -127, 127);
		return;
	}
	/* keys / consumer / buttons on the wheel: hold long enough for every transport */
	int t = entry - MAP_WHEEL_UP;

	if (tap_left_ms[t] > 0) {
		release(entry);
	}
	press(entry);
	tap_left_ms[t] = TAP_MS;
}

/* drop a pressed entry without running its release action (it became a combo key) */
static void cancel(uint8_t entry)
{
	drop_owned(entry);
	if (mp.running && mp.entry == entry && mp.mode == 3) {
		macro_stop();
	}
	if (sniper && sniper_owner == entry) {
		sniper = false;
		sniper_owner = 0xFF;
		dpi_apply();
	}
}

void actions_set_suppressed(uint8_t mask)
{
	suppressed = mask;
}

void actions_reset(void)
{
	macro_stop();
	sniper = false;
	sniper_owner = 0xFF;
	dpi_apply();
}

void actions_host_synced(bool mouse, bool kbd)
{
	if ((mp.out_wait == MP_OUT_MOUSE && mouse) || (mp.out_wait == MP_OUT_KBD && kbd)) {
		mp.out_wait = 0;
	}
}

void actions_tick(uint8_t phys, int8_t wheel, uint32_t elapsed_ms, struct host_state *hs)
{
	uint8_t cancelled = prev_phys & suppressed;

	for (uint8_t e = 0; e < 6; e++) {
		if (cancelled & BIT(e)) {
			cancel(e);
		}
	}
	prev_phys &= ~suppressed;

	uint8_t eff = phys & ~suppressed;
	uint8_t changed = eff ^ prev_phys;

	for (uint8_t e = 0; e < 6; e++) {
		if (changed & BIT(e)) {
			if (eff & BIT(e)) {
				press(e);
				leds_fx_reactive_trigger();	/* stock: every press */
			} else {
				release(e);
			}
		}
	}
	prev_phys = eff;

	for (int t = 0; t < 2; t++) {
		if (tap_left_ms[t] > 0) {
			tap_left_ms[t] -= elapsed_ms;
			if (tap_left_ms[t] <= 0) {
				release(MAP_WHEEL_UP + t);
			}
		}
	}
	for (int i = 0; i < (wheel < 0 ? -wheel : wheel); i++) {
		wheel_tap(wheel > 0 ? MAP_WHEEL_UP : MAP_WHEEL_DOWN, hs);
		leds_fx_reactive_trigger();	/* stock: every wheel detent */
	}

	macro_tick(elapsed_ms);

	/* compose the host view */
	uint8_t mbtn = mp.mbtn;

	for (int e = 0; e < BTN_MAP_ENTRIES; e++) {
		mbtn |= own_mbtn[e];
	}
	hs->mbtn = mbtn;
	hs->consumer = consumer_owner < BTN_MAP_ENTRIES ? own_consumer[consumer_owner] : 0;
	if (btn_wheel) {
		hs->wheel = CLAMP(hs->wheel + btn_wheel, -127, 127);
		btn_wheel = 0;
	}
	if (mp.wheel) {
		hs->wheel = CLAMP(hs->wheel + mp.wheel, -127, 127);
		mp.wheel = 0;
	}

	/* keyboard: modifiers from every E0..E7, up to 6 other keys (stock bug fixed) */
	uint8_t mod = mp.kmod, n = 0;

	memset(hs->keys, 0, sizeof(hs->keys));
	for (int i = 0; i < 6; i++) {
		uint8_t k = btn_keys[i];

		if (k >= 0xE0 && k <= 0xE7) {
			mod |= BIT(k - 0xE0);
		} else if (k && n < 6) {
			hs->keys[n++] = k;
		}
	}
	for (int i = 0; i < 6 && n < 6; i++) {
		if (mp.keys[i]) {
			hs->keys[n++] = mp.keys[i];
		}
	}
	hs->kmod = mod;
}

void actions_init(void)
{
	memset(&mp, 0, sizeof(mp));
	sniper = false;
	dpi_apply();
}
```

## src/actions.h
```c
/*
 * Button actions (stock button map, 8 entries x {type, code, aux}) and macro player.
 * Spec: re/actions_macros.md. Stock bugs listed there are fixed, not copied.
 */
#pragma once

#include <stdbool.h>
#include <stdint.h>

/* Physical map entries, stock order */
enum map_entry {
	MAP_LEFT = 0,
	MAP_RIGHT = 1,
	MAP_MIDDLE = 2,
	MAP_FORWARD = 3,	/* P1.04 */
	MAP_BACK = 4,		/* P1.02 */
	MAP_DPI = 5,
	MAP_WHEEL_UP = 6,
	MAP_WHEEL_DOWN = 7,
};

/* What the host should currently see, built from button actions + macros */
struct host_state {
	uint8_t mbtn;		/* HID mouse buttons */
	int8_t wheel;		/* accumulated wheel steps to send */
	uint8_t kmod;		/* keyboard modifier bitmap */
	uint8_t keys[6];	/* keyboard key usages */
	uint16_t consumer;	/* consumer usage, 0 = none */
};

void actions_init(void);
/*
 * Call every tick with the debounced physical state of map entries 0..5 (bit n =
 * entry n) and the wheel detents since the last call (+ = up). Updates *hs.
 */
void actions_tick(uint8_t phys, int8_t wheel, uint32_t elapsed_ms, struct host_state *hs);
/* Suppress map actions of these physical entries (combo keys) */
void actions_set_suppressed(uint8_t mask);
bool actions_busy(void);	/* macro playing: keep the mouse awake */
/* map/macros replaced (factory reset, DF): stop the player, drop the sniper */
void actions_reset(void);
/* after the report step: which host views equal the current state (macro handshake) */
void actions_host_synced(bool mouse, bool kbd);

/* DPI helpers shared with the vendor protocol */
void dpi_apply(void);			/* write current stage (or sniper) to the sensor */
void dpi_step(uint8_t mode);		/* 0 up, 1 down, 2 up-wrap, 3 down-wrap */
void dpi_select(uint8_t stage);
uint8_t dpi_current(void);
bool dpi_sniper_active(void);
```

## src/hid_desc.h
```c
/* Mouse report descriptor shared by USB (no report ID) and BLE (report ID 1). */
#pragma once
#include <stdint.h>
#include "pulsedart.h"

#define MOUSE_REPORT_LEN 6	/* buttons, X lo/hi, Y lo/hi, wheel */

#define MOUSE_DESC_BODY                                                         \
	0x05, 0x09,		/*   Usage Page (Buttons) */                    \
	0x19, 0x01,		/*   Usage Minimum (1) */                       \
	0x29, 0x05,		/*   Usage Maximum (5) */                       \
	0x15, 0x00,		/*   Logical Minimum (0) */                     \
	0x25, 0x01,		/*   Logical Maximum (1) */                     \
	0x95, 0x05,		/*   Report Count (5) */                        \
	0x75, 0x01,		/*   Report Size (1) */                         \
	0x81, 0x02,		/*   Input (Data,Var,Abs) */                    \
	0x95, 0x01,		/*   Report Count (1) */                        \
	0x75, 0x03,		/*   Report Size (3) */                         \
	0x81, 0x01,		/*   Input (Const) */                           \
	0x05, 0x01,		/*   Usage Page (Generic Desktop) */            \
	0x09, 0x30,		/*   Usage (X) */                               \
	0x09, 0x31,		/*   Usage (Y) */                               \
	0x16, 0x01, 0x80,	/*   Logical Minimum (-32767) */                \
	0x26, 0xFF, 0x7F,	/*   Logical Maximum (32767) */                 \
	0x75, 0x10,		/*   Report Size (16) */                        \
	0x95, 0x02,		/*   Report Count (2) */                        \
	0x81, 0x06,		/*   Input (Data,Var,Rel) */                    \
	0x09, 0x38,		/*   Usage (Wheel) */                           \
	0x15, 0x81,		/*   Logical Minimum (-127) */                  \
	0x25, 0x7F,		/*   Logical Maximum (127) */                   \
	0x75, 0x08,		/*   Report Size (8) */                         \
	0x95, 0x01,		/*   Report Count (1) */                        \
	0x81, 0x06		/*   Input (Data,Var,Rel) */

#define MOUSE_DESC(...)                                             \
	0x05, 0x01,		/* Usage Page (Generic Desktop) */              \
	0x09, 0x02,		/* Usage (Mouse) */                             \
	0xA1, 0x01,		/* Collection (Application) */                  \
	__VA_ARGS__                                                             \
	0x09, 0x01,		/*   Usage (Pointer) */                         \
	0xA1, 0x00,		/*   Collection (Physical) */                   \
	MOUSE_DESC_BODY,                                                        \
	0xC0,			/*   End Collection */                          \
	0xC0			/* End Collection */

static inline void mouse_report_pack(uint8_t *out, const struct mouse_report *r)
{
	out[0] = r->buttons & 0x1F;
	out[1] = (uint8_t)r->dx;
	out[2] = (uint8_t)((uint16_t)r->dx >> 8);
	out[3] = (uint8_t)r->dy;
	out[4] = (uint8_t)((uint16_t)r->dy >> 8);
	out[5] = (uint8_t)r->wheel;
}
```

## src/input.c
```c
/*
 * Buttons and scroll wheel, polled every 1 ms like the stock firmware.
 * Debounce: 5 ms press / 18 ms release (stock values set at boot, re/input_usb_led.md).
 * Wheel: the stock firmware enables the encoder pull-ups only while sampling to
 * avoid a constant current through a contact that rests closed; we do the same.
 */
#include <zephyr/kernel.h>
#include <zephyr/drivers/gpio.h>
#include <zephyr/logging/log.h>

#include "pulsedart.h"

LOG_MODULE_REGISTER(input, LOG_LEVEL_INF);

static uint8_t debounce_press_ms = 5;	/* stock boot values; NGENUITY D0 54 78 */
static uint8_t debounce_release_ms = 18;

void input_set_debounce(uint8_t press_ms, uint8_t release_ms)
{
	debounce_press_ms = MAX(press_ms, 1);
	debounce_release_ms = MAX(release_ms, 1);
}

/* Wheel direction is not confirmed on hardware yet (re/input_usb_led.md); flip here */
#define WHEEL_INVERT 0

#define BTN(node) GPIO_DT_SPEC_GET(DT_NODELABEL(node), gpios)

static const struct {
	struct gpio_dt_spec spec;
	uint8_t bit;
} buttons[] = {
	{BTN(btn_left), BTN_LEFT},     {BTN(btn_right), BTN_RIGHT},
	{BTN(btn_middle), BTN_MIDDLE}, {BTN(btn_back), BTN_BACK},
	{BTN(btn_fwd), BTN_FORWARD},   {BTN(btn_dpi), BTN_DPI},
};

static const struct gpio_dt_spec wheel_a =
	GPIO_DT_SPEC_GET(DT_PATH(zephyr_user), wheel_a_gpios);
static const struct gpio_dt_spec wheel_b =
	GPIO_DT_SPEC_GET(DT_PATH(zephyr_user), wheel_b_gpios);

static uint8_t state;
static uint8_t counter[ARRAY_SIZE(buttons)];
static uint8_t wheel_prev;
static int8_t wheel_acc;

int input_init(void)
{
	for (size_t i = 0; i < ARRAY_SIZE(buttons); i++) {
		gpio_pin_configure_dt(&buttons[i].spec, GPIO_INPUT);
	}
	gpio_pin_configure_dt(&wheel_a, GPIO_DISCONNECTED);
	gpio_pin_configure_dt(&wheel_b, GPIO_DISCONNECTED);
	return 0;
}

uint8_t input_poll_buttons(uint8_t elapsed_ms)
{
	for (size_t i = 0; i < ARRAY_SIZE(buttons); i++) {
		bool raw = gpio_pin_get_dt(&buttons[i].spec) == 1;
		bool cur = state & buttons[i].bit;

		if (raw == cur) {
			counter[i] = 0;
			continue;
		}
		counter[i] = MIN(counter[i] + elapsed_ms, UINT8_MAX);
		if (counter[i] >= (raw ? debounce_press_ms : debounce_release_ms)) {
			state ^= buttons[i].bit;
			counter[i] = 0;
		}
	}
	return state;
}

static uint8_t wheel_sample(void)
{
	gpio_pin_configure_dt(&wheel_a, GPIO_INPUT | GPIO_PULL_UP);
	gpio_pin_configure_dt(&wheel_b, GPIO_INPUT | GPIO_PULL_UP);
	k_busy_wait(10);	/* stock: ~10 us */
	/* stock bit order: A in bit 0, B in bit 1 */
	uint8_t s = (gpio_pin_get_dt(&wheel_b) << 1) | gpio_pin_get_dt(&wheel_a);

	/* disconnected, not floating inputs, between samples (stock 0x5c930) */
	gpio_pin_configure_dt(&wheel_a, GPIO_DISCONNECTED);
	gpio_pin_configure_dt(&wheel_b, GPIO_DISCONNECTED);
	return s;
}

int8_t input_poll_wheel(void)
{
	/* Gray-code transition table: +1 / -1 per valid step, 0 for none/invalid */
	static const int8_t table[16] = {
		0, -1, 1, 0,
		1, 0, 0, -1,
		-1, 0, 0, 1,
		0, 1, -1, 0,
	};
	uint8_t s = wheel_sample();

	wheel_acc += table[(wheel_prev << 2) | s];
	wheel_prev = s;

	/* one detent = two valid transitions (stock) */
	int8_t out = wheel_acc / 2;

	wheel_acc -= out * 2;
	return WHEEL_INVERT ? -out : out;
}

/* stock 0x56d96: wheel pull-ups on, SENSE opposite to the current level, so a step wakes */
void input_prepare_sleep(void)
{
	const struct gpio_dt_spec *w[] = {&wheel_a, &wheel_b};

	for (size_t i = 0; i < ARRAY_SIZE(w); i++) {
		gpio_pin_configure_dt(w[i], GPIO_INPUT | GPIO_PULL_UP);
	}
	k_busy_wait(10);
	for (size_t i = 0; i < ARRAY_SIZE(w); i++) {
		gpio_pin_interrupt_configure_dt(w[i], gpio_pin_get_raw(w[i]->port, w[i]->pin) ?
						      GPIO_INT_LEVEL_LOW : GPIO_INT_LEVEL_HIGH);
	}
}
```

## src/leds.c
```c
/*
 * Two RGB zones on PWM0/PWM1 (pin map from the stock PWM table @0x646c4).
 * Stock limits the duty to ~80 %, we keep the same ceiling.
 */
#include <zephyr/kernel.h>
#include <zephyr/drivers/pwm.h>
#include <zephyr/drivers/gpio.h>

#include "pulsedart.h"

#define PWM_LED(node) PWM_DT_SPEC_GET(DT_NODELABEL(node))

static const struct pwm_dt_spec led[2][3] = {
	{PWM_LED(pwm_led0_r), PWM_LED(pwm_led0_g), PWM_LED(pwm_led0_b)},
	{PWM_LED(pwm_led1_r), PWM_LED(pwm_led1_g), PWM_LED(pwm_led1_b)},
};

static const struct gpio_dt_spec led_en =
	GPIO_DT_SPEC_GET(DT_PATH(zephyr_user), led_enable_gpios);

static uint8_t cache[2][3];
static bool zone_valid[2];

static void set_channel(const struct pwm_dt_spec *s, uint8_t v)
{
	/* stock: compare = 320 - v with a 320-count period, i.e. duty = v / 320 */
	uint32_t pulse = (uint64_t)s->period * v / 320;

	pwm_set_pulse_dt(s, pulse);
}

void leds_set(uint8_t zone, uint8_t r, uint8_t g, uint8_t b)
{
	if (zone > 1) {
		return;
	}
	const uint8_t v[3] = {r, g, b};

	bool any = false;

	for (int c = 0; c < 3; c++) {
		if (!zone_valid[zone] || cache[zone][c] != v[c]) {
			cache[zone][c] = v[c];
			set_channel(&led[zone][c], v[c]);
		}
	}
	zone_valid[zone] = true;
	/* LED supply (P0.24) on only while some channel is lit */
	for (int z = 0; z < 2; z++) {
		for (int c = 0; c < 3; c++) {
			any |= cache[z][c] != 0;
		}
	}
	gpio_pin_set_dt(&led_en, any);
}

void leds_set_all(uint8_t r, uint8_t g, uint8_t b)
{
	leds_set(0, r, g, b);
	leds_set(1, r, g, b);
}

void leds_off(void)
{
	leds_set_all(0, 0, 0);
}

int leds_init(void)
{
	gpio_pin_configure_dt(&led_en, GPIO_OUTPUT_INACTIVE);
	for (int z = 0; z < 2; z++) {
		for (int c = 0; c < 3; c++) {
			if (!pwm_is_ready_dt(&led[z][c])) {
				return -ENODEV;
			}
		}
	}
	leds_off();
	return 0;
}
```

## src/leds_fx.h
```c
/*
 * Stock lighting engine (re/led_effects.md): per-zone effects 0 static, 1 spectrum
 * (hue cycle or c1<->c2 cross-fade), 2 breathing, 3 reactive; system indications for
 * DPI, charging, low battery, pairing. Zone 0 = rear logo, zone 1 = scroll wheel.
 */
#pragma once

#include <stdbool.h>
#include <stdint.h>

void leds_fx_init(void);
void leds_fx_apply_all(void);		/* re-read zone settings from scfg */
void leds_fx_apply_zone(uint8_t z);
void leds_fx_tick(uint32_t elapsed_ms);
void leds_fx_indicate_dpi(uint8_t stage);
void leds_fx_reactive_trigger(void);	/* button press / wheel detent */
void leds_fx_set_lowbat(uint8_t level);	/* 0 none, 1 critical (<5 %), 2 low */
void leds_fx_set_charging(bool charging);
void leds_fx_set_pairing(bool on);
void leds_fx_suspend(bool off);		/* sleep / USB suspend: all dark */
void leds_fx_flash(uint8_t r, uint8_t g, uint8_t b);	/* 3 blinks, full brightness */
```
